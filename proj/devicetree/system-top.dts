/*
 * CAUTION: This file is automatically generated by Xilinx.
 * Version: XSCT 2024.1
 * Today is: Thu Nov  7 23:48:31 2024
 */


/dts-v1/;
#include "zynqmp.dtsi"
#include "zynqmp-clk-ccf.dtsi"
#include "pcw.dtsi"
/ {
	chosen {
		bootargs = "earlycon";
	};
	aliases {
		i2c0 = &i2c1;
		serial0 = &dcc;
		spi0 = &qspi;
		spi1 = &spi1;
	};
	memory@0 {
		device_type = "memory";
		reg = <0x0 0x0 0x0 0x7ff00000>, <0x00000008 0x00000000 0x0 0x80000000>;
	};
};
